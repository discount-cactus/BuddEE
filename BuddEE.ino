// Arduino-Based Digital Multimeter/Waveform Generator/Oscilloscope Module

/*  Instructions:
*   In void loop(), all functions are commented out. To use a function,
*   uncomment it, and the function will run properly
*
*   When using the generate_waveform() function, you will need to set the shape
*   of the waveform.
*     0 = Pulse
*     1 = Triangle
      2 = Saw
      3 = Sine
*
*
*/

//Multimeter variables
#define Voltmeter A0
#define Ammeter A1
#define Ohmmeter A2
#define Capacitancmeter A3
#define Inductancemeter 7
#define Continuitymeter A4

float voltage = 0.00;
float current = 0.00; 
float resistance = 0.00; 
float capacitance = 0.00;
float inductance = 0.00;
int continuity_signal = 0;

//Waveform Generator variables
#define potPin_frequency A7
#define potPin_PWM A6

int shape = 3;

//PWM potentiometer monitoring variables
float pulseWidth;
int pulseWidthScaled;
int PWCurrent;
byte PWTolerance = 8;         //adjust this to increase/decrease stability of PW measurement

//Frequency potentiometer monitoring variables
int frequency;
int freqCurrent;
byte freqTolerance = 2;       //adjust this to increase/decrease stability of frequency measurement
unsigned int freqscaled;

const byte sine20000[] PROGMEM = {127, 127, 127, 127, 127, 127, 127, 127, 127, 127, 127, 127, 127,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 126,};
byte wave;
long t;
long samplerate = 100000;
long period;

//storage variables- I used these to cut down on the math being performed during the interrupt
int sawByte = 0;
byte sawInc;
int triByte = 0;
byte triInc;
int sinNum = 0;
int sinInc;

//Oscilloscope variables
#define OSCpin A8



void calculate_voltage() { 
  float R1 = 1000000.00; 
  float R2 = 100000.00; 
  float v_ref = 5.00; 
  float resistor_ratio = (R2 / (R1 + R2)); 
  float adc_value = 0.00; 
  float v = 0.00;
  for (int i = 0; i < 20 ; i++) 
  { 
    adc_value = adc_value + analogRead(Voltmeter);
    delay(3); 
  } 
  adc_value = adc_value / 20; 
  v = ((adc_value * v_ref) / 1024); 
  voltage = v / resistor_ratio;

  Serial.print(voltage); 
  Serial.println(" v");

  delay(500);
}

void calculate_current() { 
  int sensitivity = 185; 
  int adc_value = 0; 
  float v_ref = 4.94; 
  float voltage = 0.00; 
  float pure_voltage = 0.00; 
  float offset_voltage = 2.47; 
  for (int i = 0; i < 40 ; i++) 
  { 
    adc_value = adc_value + analogRead(Ammeter); 
    delay(2); 
  } 
  adc_value = adc_value / 40; 
  voltage = ((adc_value * v_ref) / 1024); 
  pure_voltage = voltage - offset_voltage; 
 // if(pure_voltage > 0.001) pure_voltage = 0.00; 
  pure_voltage = pure_voltage * 1000; 
  current = pure_voltage / sensitivity;
  Serial.println(String("I = ") + current + "A");

  delay(500);
}

void calculate_resistance() {
  const int R1 = 4;
  const int R2 = 5;
  const int R3 = 6;
  
  float v_ref = 4.94; 
  float r1 = 0.00; 
  float r_ref1 = 1000.00; 
  float adc_value1 = 0.00;
  float voltage1 = 0.00; 
  float r2 = 0.00; 
  float r_ref2 = 10000.00;
  float adc_value2 = 0.00;
  float voltage2 = 0.00; 
  float r3 = 0.00; 
  float r_ref3 = 100000.00; 
  float adc_value3 = 0.00;
  float voltage3 = 0.00; 
  
  pinMode(R1,OUTPUT);
  pinMode(R2,INPUT);
  pinMode(R3,INPUT);
  digitalWrite(R1,HIGH); 
  for (int i = 0; i < 20 ; i++){ 
    adc_value1 = adc_value1 + analogRead(Ohmmeter); 
    delay(3); 
  } 

  adc_value1 = adc_value1 / 20; 

  if (adc_value1 < 1022.90){ 
    voltage1 = ((adc_value1 * v_ref) / 1024); 
    r1 = (voltage1 * r_ref1) / (v_ref - voltage1); 
  }
  
  pinMode(R1,INPUT); 
  pinMode(R2,OUTPUT); 
  pinMode(R3,INPUT); 
  digitalWrite(R2,HIGH); 
  for (int i = 0; i < 20 ; i++){ 
    adc_value2 = adc_value2 + analogRead(Ohmmeter); 
    delay(3); 
  } 
  adc_value2 = adc_value2 / 20; 
  if (adc_value2 < 1022.90){ 
    voltage2 = ((adc_value2 * v_ref) / 1024); 

    r2 = (voltage2 * r_ref2) / (v_ref - voltage2); 
  }
  
  pinMode(R1,INPUT); 
  pinMode(R2,INPUT); 
  pinMode(R3,OUTPUT); 
  digitalWrite(R3,HIGH); 
  for (int i = 0; i < 20 ; i++){ 
    adc_value3 = adc_value3 + analogRead(Ohmmeter); 
    delay(3); 
  } 
  adc_value3 = adc_value3 / 20; 
  if (adc_value3 < 1022.90){ 
    voltage3 = ((adc_value3 * v_ref) / 1024); 
    r3 = (voltage3 * r_ref3) / (v_ref - voltage2); 
  }
  
  r1 = r1 / 1000; 
  r2 = r2 / 1000; 
  r3 = r3 / 1000; 
  if (r1 < 2 && r2 < 101 && r3 < 1001) resistance = r1*1000; 
  else if (r1 > 2 && r2 < 101 && r3 < 1001) resistance = r2; 
  else if (r1 > 2 && r2 > 101 && r3 < 2000) resistance = r3; 
  else resistance = 0.00; 
  Serial.print("R = "); 
  Serial.println(resistance, 2);

  delay(500);
} 

void calculate_capacitance(){
  const int ChargePin = 2;
  const int DischargePin = 3;

  unsigned long start_time;
  unsigned long elapsed_time; 
  float microFarads; 
  float nanoFarads; 
  float r_ref = 10000.00;
  digitalWrite(ChargePin,HIGH);
  start_time = millis();
  //Serial.println(analogRead(Capacitancmeter));
  while (analogRead(Capacitancmeter) < 648) {
    Serial.println("Charging: " + String(analogRead(Capacitancmeter)) + "/648");
  }
  elapsed_time = millis() - start_time;
  microFarads = ((float)elapsed_time / r_ref) * 1000;
  if (microFarads > 1){
    capacitance = microFarads;

    Serial.print("Capacitance (uF): ");
    Serial.println(capacitance);
  
  }else{ 
    nanoFarads = microFarads * 1000.0;
    capacitance = nanoFarads;

    Serial.print("Capacitance (nF): ");
    Serial.println(capacitance);
  }
  
  digitalWrite(ChargePin,LOW);
  pinMode(DischargePin,OUTPUT);
  digitalWrite(DischargePin,LOW);
  while (analogRead(Capacitancmeter) > 0) {}
  pinMode(DischargePin,INPUT);

  delay(500);
}

void calculate_inductance(){
  const int ChargePin = 8;

  digitalWrite(ChargePin,HIGH);
  delay(5);                                               //give some time to charge inductor.
  digitalWrite(ChargePin,LOW);
  delayMicroseconds(100);                                 //make sure resination is measured
  double pulse = pulseIn(Inductancemeter,HIGH,5000);      //returns 0 if timeout
  if (pulse > 0.1){                                       //if a timeout did not occur and it took a reading:
    double capacitance = 2.E-6;                           // 2 x 1uF capacitors in parallel
    double frequency = 1.E6/(2*pulse);
    inductance = 1./(capacitance*frequency*frequency*4.*3.14159*3.14159);
    inductance *= 1000.00;                                //Comment this out to convert the output to uH
    Serial.print("inductance (mH):");
    Serial.println(inductance);
  }
}

void calculate_continuity(){
  const int continuity_signal_pin = 9;
  pinMode(continuity_signal_pin,OUTPUT);
  digitalWrite(continuity_signal_pin,HIGH);
  continuity_signal = analogRead(Continuitymeter);

  Serial.print("Continuity Signal: ");
  Serial.println(continuity_signal);

  delay(500);
}

/*ISR(TIMER1_COMPA_vect){   //timer 1 interrupt
  //increment t and reset each time it reaches period
  t++;
  if (t >= period){
    t = 0;
  }
  
  switch(shape){
    case 0:   //Pulse
      if (pulseWidthScaled <= t){
        wave = 255;
      }else{
        wave = 0;
      }
      break;
    case 1:   //Triangle
      if((period - t) > t){
        if (t == 0){
          triByte = 0;
        }else{
          triByte += triInc;
        }
      }else{
        triByte -= triInc;
      }
      if (triByte > 255){
        triByte = 255;
      }else if (triByte < 0){
        triByte = 0;
      }
      wave = triByte;
      break;
    case 2:   //Saw
      if (t == 0){
        sawByte = 0;
      }else{
        sawByte += sawInc;
      }
      wave = sawByte;
      break;
    case 3:   //Sine
      sinNum = t * sinInc;
      wave = pgm_read_byte_near(sine20000 + sinNum);
      break;
  }

  PORTL = wave; //pins 42-49
}*/



void generate_waveform(){
  freqCurrent = analogRead(potPin_frequency);
  if (abs(freqCurrent - frequency) > freqTolerance){  //if reading from pot exceeds tolerance
    frequency = freqCurrent;                          //new frequency- number between 0 and 1024
    freqscaled = 48*frequency+1;                      //from 1 to ~50,000
    period = samplerate / freqscaled;
    pulseWidthScaled = int(pulseWidth/1023*period);
    
    /*triInc = 511 / period;
    if (triInc == 0){
      triInc = 1;
    }
    sawInc = 255 / period;
    if (sawInc == 0){
      sawInc = 1;
    }
    sinInc = 20000 / period;*/
  }
  //increment t and reset each time it reaches period
  t++;
  if (t >= period){
    t = 0;
  }
  
  switch(shape){
    case 0:   //Pulse
      if (pulseWidthScaled <= t){
        wave = 255;
      }else{
        wave = 0;
      }
      break;
    case 1:   //Triangle
      if((period - t) > t){
        if (t == 0){
          triByte = 0;
        }else{
          triByte += triInc;
        }
      }else{
        triByte -= triInc;
      }
      if (triByte > 255){
        triByte = 255;
      }else if (triByte < 0){
        triByte = 0;
      }
      wave = triByte;
      break;
    case 2:   //Saw
      if (t == 0){
        sawByte = 0;
      }else{
        sawByte += sawInc;
      }
      wave = sawByte;
      break;
    case 3:   //Sine
      sinNum = t * sinInc;
      wave = pgm_read_byte_near(sine20000 + sinNum);
      break;
  }

  PORTL = wave; //pins 42-49

  PWCurrent = analogRead(potPin_PWM);
  if (abs(PWCurrent-pulseWidth) > PWTolerance){ //if reading from pot exceeds tolerance
    pulseWidth = PWCurrent;                     //new pulse width, val between 0 and 1023
    pulseWidthScaled = int(pulseWidth/1023*period);
  }

  //Prints the input parameters of the generator in the serial monitor
  Serial.print("Shape: ");
  switch(shape){
    case 0:
      Serial.println("Pulse");
      break;
    case 1:
      Serial.println("Triangle");
      break;
    case 2:
      Serial.println("Saw");
      break;
    case 3:
      Serial.println("Sine");
      break;
  }
  Serial.println("Frequency: " + String(frequency) + "Hz");
  Serial.println("Pulse Width: " + String(pulseWidth));
  Serial.println("");
}


void oscilloscope(){
  int OSC_val = analogRead(OSCpin);

  Serial.write(0xff);
  Serial.write((OSC_val >> 8) & 0xff);
  Serial.write(OSC_val & 0xff);
}



void setup() {
  Serial.begin(9600);
  //set port/pin  mode
  DDRD = 0xFF;    //all outputs
  DDRC = 0x00;    //all inputs
  DDRB = 0xFF;    //all outputs
  //TIMER INTERRUPT SETUP
  
  cli();          //disable interrupts
  //timer 1:
  //TCCR1A = 0;     // set entire TCCR1A register to 0
  //TCCR1B = 0;     // same for TCCR1B
  
  OCR1A = 159;              //set compare match register- 100khz to start,  = (16 000 000 / 100 000) - 1 = 159
  //TCCR1B |= (1 << WGM12);   //turn on CTC mode
  //TCCR1B |= (1 << CS10);    // Set CS10 bit for 0 prescaler
  //TIMSK1 |= (1 << OCIE1A);  // enable timer compare interrupt
  
  samplerate = 100000;
  
  //initialize variables
  frequency = analogRead(potPin_frequency);     //initialize frequency
  freqscaled = 48*frequency+1;    //from 1 to ~50,000 Hz
  period = samplerate/freqscaled;
   
  pulseWidth = analogRead(potPin_PWM);    //initalize pulse width
  pulseWidthScaled = int(pulseWidth/1023*period);
  
  triInc = 511/period;
  sawInc = 255/period;
  sinInc = 20000/period;
  
  sei();                    //enable interrupts
}

void loop(){
  //Serial.println(String(analogRead(Voltmeter)) + ", " + String(analogRead(Ammeter)) + ", " + String(analogRead(Ohmmeter)) + ", " + String(analogRead(Capacitancmeter)) + ", " + String(analogRead(Inductancemeter)) + ", " + String(analogRead(Continuitymeter)));
  //calculate_voltage();
  //calculate_current();
  //calculate_resistance();
  calculate_capacitance();
  //calculate_inductance();
  //calculate_continuity();
  //generate_waveform();
  //oscilloscope();
}
